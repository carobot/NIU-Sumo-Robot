#include <Wire.h>                 // Must include Wire library for I2C
#include "SparkFun_MMA8452Q.h"    // Click here to get the library: http://librarymanager/All#SparkFun_MMA8452Q
#include <FastLED.h>              // Library for the leds
#include <PCM.h>                  // libarary for the speaker

MMA8452Q accel;                   // create instance of the MMA8452 class
#define NUM_LEDS 6               // Number of leds on the strip

#define DATA_PIN 15                // data pin for led strip
#define BRIGHTNESS 50             // Brightness of leds

CRGB leds[NUM_LEDS];              // Define the array of leds

const unsigned char sample[] PROGMEM = { // for the sound played on the speaker
  126, 126, 126, 127, 127, 127, 128, 128, 128, 128, 128, 128,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 128,  
};

void setup() {
  Serial.begin(9600);
  Wire.begin();

  if (accel.begin() == false) {
    Serial.println("Not Connected. Please check connections and read the hookup guide.");
    while (1);
  }
  FastLED.addLeds<NEOPIXEL, DATA_PIN>(leds, NUM_LEDS);  // GRB ordering is assumed
  FastLED.setBrightness(BRIGHTNESS);
  for(int i = 0; i<6; i++){    // turn on the leds one by one 
        leds[i] = CRGB::Red;
      }
      FastLED.show();               // sends all the led data to all the leds
      delay(100);
}

void loop() {
  if (accel.available()) {      // Wait for new data from accelerometer
    // Prints "Collision" each time accelerometer detects a tap
    if (accel.readTap() > 0) {
      Serial.println("Collision");
      startPlayback(sample, sizeof(sample));
      for(int i = 0; i<6; i++){    // turn on the leds one by one 
        leds[i] = CRGB::White;
      }
      FastLED.show();               // sends all the led data to all the leds
      delay(200);                   // To keep the leds on for a while
      for(int i = 0; i<6; i++){    // turn on the leds one by one 
        leds[i] = CRGB::Black;
      }
      FastLED.show();               // sends all the led data to all the leds
      delay(100);
      for(int i = 0; i<6; i++){    // turn on the leds one by one 
        leds[i] = CRGB::White;
      }
      FastLED.show();               // sends all the led data to all the leds
      delay(100);  
    for(int i = 0; i<6; i++){    // turn off the leds 
    leds[i] = CRGB::Red;
  }
  FastLED.show();  
    }
  }

}
